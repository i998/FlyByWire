/*
v1.0 - PCA9685 Oscillator Frequency Test   
  
Status: Works OK

Change list: 

v1.0:  
- Created for STM32 Maple Mini and  PCA9685ServoDriver library 

Notes:
- Compiled with Fastest (-O3) settings 

=================================================================
(C)2021 ifh  
This file is part of Fly By Wire.

Fly By Wire is free software: you can redistribute it and/or modify
it under the terms of the GNU General Public License as published by
the Free Software Foundation, either version 3 of the License, or
(at your option) any later version.

Fly By Wire is distributed in the hope that it will be useful,
but WITHOUT ANY WARRANTY; without even the implied warranty of
MERCHANTABILITY or FITNESS FOR A PARTICULAR PURPOSE.  See the
GNU General Public License for more details.

The above copyright notice and this permission notice shall be 
included in all copies or substantial portions of the Software.

=================================================================
/***************************************************
  Original idea: https://github.com/adafruit/Adafruit-PWM-Servo-Driver-Library/blob/master/examples/oscillator/oscillator.ino
  Modified to use with Fly By Wire and STM32 Maple Mini hardware
  
  This is a Frequency Test example for PCA9685ServoDriver library 
  to calibrate the frequency of the oscillator clock of the PCA9685.
  
  It is known the internal oscillator of PCA9685 boards is not 
  exactly 25MHz, and that affects calculations of the lengths of 
  the servo pulses generated by the board.   
  
  The setup will feed the PCA9685 output back into the CPU board to 
  measure the actual frequency of PCA9685 internal oscillator and 
  calculate an adjustment value for PCA9685ServoDriver library.  
   
  CAUTION: DO NOT CONNECT ANY VOLTAGE HIGHER THAN THE BOARD LIMITS.
  For 3.3V boards, or 5v-tolerant inputs or use level shifters.    
  
  Connect the signal (yellow pin, PWM) of the PCA9685 board
  Default is pin 15, last of the last block (that would be channel 16 
  for the PCA9685ServoDriver) to the Mapple Mini CPU board input pin.  
  Default is pin Pin D22 of your Mapple Mini CPU board.

  Run the serial monitor and look at the output like this:

      countDeviations:190
      Timestamp:190
      Freq:52
      Counter:9985
      calc.osci.freq    :26261180
      calc.osci.freq.avg:26261748
      freqCalibration:1.0505
      ===========

  Over several iterations the calculations will stabilise and you can see 
  your PCA9685 board's internal oscillator frequency (calc.osci.freq.avg)
  and an adjustment value (freqCalibration) you can then apply when you 
  initialise the servo driver.
  
  Formula for prescale to get the targetted frequency (=update_rate) is:
  prescale = round ( osc_clock / 4096 * update_rate) - 1
  rewritten: osc_clock = (prescale + 1) * 4096 * update_rate
  This example measures the real update_rate to assert the real osc_clock, 
  then averages it with previous calculations and derives a an adjustment value
  that you can use for the PCA9685ServoDriver library.
  ***************************************************/

//use local copies of the libraries 
#include "src\PCA9685ServoDriver.h"

//======Setup I2C interface===================================
//TwoWire I2C_FAST (1,I2C_FAST_MODE); //I2C1 
//TwoWire I2C_FAST (2,I2C_FAST_MODE); //I2C2 
TwoWire I2C_FAST=TwoWire(1,I2C_FAST_MODE); //I2C1  
//TwoWire I2C_FAST=TwoWire(2,I2C_FAST_MODE); //I2C2

//============================================================


//=======Define Servo Driver and number of output signals  ===
// called this way, it uses the default address 0x40
//PCA9685ServoDriver pwm = PCA9685ServoDriver();
// you can also call it with a different address you want
//PCA9685ServoDriver pwm = PCA9685ServoDriver(0x41);
// you can also call it with a different address and I2C interface
//PCA9685ServoDriver pwm = PCA9685ServoDriver(&Wire, 0x40);

PCA9685ServoDriver pwm = PCA9685ServoDriver(&I2C_FAST, 0x40);
int channelAmountOut = 12;
uint16_t channelsOUT[17];  // for write 16 channels, 1..16

#if defined(_BOARD_MAPLE_MINI_H_) 

// Applied frequency in the test: can be changed to get the optimal
// oscillator calibration for your targetted frequency.
#define FREQUENCY             50

//PCA9685 board:
//Set pin for servo signal output 
#define PIN_SERVO_OUTPUT    15 // Connect Yellow PWM pin 15 (last on the last block). This is channel 16 for the PCA9685ServoDriver.

//Maple Mini CPU board: 
//Set pin for servo signal input
//http://docs.leaflabs.com/static.leaflabs.com/pub/leaflabs/maple-docs/latest/hardware/maple-mini.html#
//only one pin per EXTI line can be used for external interrupts at a time
//only 5v compatible pins (marked  with *) to be used for direct input from PCA9685
/* 
        EXTI Line       Pins
        EXTI0           D3, D11
        EXTI1           D10, D33
        EXTI2           D2*, D9
        EXTI3           D8, D19*
        EXTI4           D7, D18*
        EXTI5           D6, D17
        EXTI6           D5, D16*
        EXTI7           D4, D15*
        EXTI8           D27*, D32*
        EXTI9           D26*
        EXTI10          D1*, D25*
        EXTI11          D0*, D24*
        EXTI12          D23*, D31*
        EXTI13          D14, D22*, D30*
        EXTI14          D13, D21*, D29*
        EXTI15          D12, D20*, D28* 
*/
#define PIN_BOARD_INPUT 22 // Pin D22 => GPIO PA13
uint8_t prescale = 0;
// loop
#define INTERVAL   1000  // 1 sec
int32_t lastEvaluation = 0;
uint16_t frozenCounter = 0;
uint16_t countDeviations = 0;

uint32_t totalCounter = 0;
uint32_t totalTime = 0;   // in millis
uint32_t realOsciFreq = 0;
uint32_t realOsciFreqAvg = 25000000;
uint32_t multiplier = 4096;
float    freqCalibration=0;

// interrupt counter
volatile uint16_t interruptCounter = 0;

// Interrupt Service Routine 
void ISR() {
  interruptCounter++;
}

void setup() {
  
  //==============================
   Serial.begin(9600);
   //Serial.begin(115200);
   //The program will wait for serial to be ready up to 10 sec then it will continue anyway  
     for (int i=1; i<=10; i++){
          delay(1000);
     if (Serial){
         break;
       }
     }
    Serial.println("Setup() started ");
    Serial.println("PCA9685 Oscillator test");
  //===============================
 
  // set PCA9685
  pwm.begin();
  pwm.oscillator_freq = 25000000; // set default oscillator frequency 
  pwm.freqCalibration = 1; // set default multiplier  
  
  pwm.setPWMFreq(FREQUENCY);             // Set some frequency
  pwm.setPWM(PIN_SERVO_OUTPUT+1,0,2048); // half of time high, half of time low. PIN_SERVO_OUTPUT+1 as PCA9685ServoDriver takes input as a channel number, {1..16} 
  prescale = pwm.readPrescale();         // read prescale from the PCA9685 chip
  Serial.print("Target frequency:"); Serial.println(String(FREQUENCY));
  Serial.print("Applied prescale:"); Serial.println(String(prescale));

  // prepare interrupt on the CPU board pin
  pinMode(PIN_BOARD_INPUT, INPUT_PULLDOWN);
  attachInterrupt(PIN_BOARD_INPUT, ISR, RISING);

  // take a breath and reset to zero
  delay(10);
  interruptCounter = 0;
  lastEvaluation = millis();
}// end of setup()

void loop() {
  if (millis() - lastEvaluation > INTERVAL)
  {
    // first freeze counters and adjust for new round
    frozenCounter = interruptCounter; // first freeze counter
    interruptCounter -= frozenCounter;
    lastEvaluation += INTERVAL;

    totalCounter += frozenCounter;
    totalTime += 1;

    // only print deviations from targeted frequency
    //if (frozenCounter != FREQUENCY)
    {
       multiplier = 4096;
       realOsciFreq = (prescale + 1) * totalCounter; // first part calculation
       // now follows an ugly hack to have maximum precision in 32 bits
       while (((realOsciFreq & 0x80000000) == 0) && (multiplier != 1))
       {
          realOsciFreq <<= 1;
          multiplier >>= 1;
       }
       realOsciFreq /= totalTime;
       if (multiplier) realOsciFreq *= multiplier;

       countDeviations++;
       
       //calc average over time and freqCalibration 
       realOsciFreqAvg=(realOsciFreqAvg+realOsciFreq)/2;
       freqCalibration= (float) realOsciFreqAvg/25000000;
       
       Serial.print("countDeviations:"); Serial.println(String(countDeviations));
       Serial.print("Timestamp:"); Serial.println(String(totalTime));
       Serial.print("Freq:"); Serial.println(String(frozenCounter));
       Serial.print("Counter:"); Serial.println(String(totalCounter));
       Serial.print("calc.osci.freq    :"); Serial.println(String(realOsciFreq));
       Serial.print("calc.osci.freq.avg:"); Serial.println(String(realOsciFreqAvg));
       Serial.print("freqCalibration:"); Serial.println(freqCalibration,4);
       Serial.println("===========");
    }
  }// end of loop()

}
#else

void setup() {
  //==============================
   Serial.begin(9600);
   //Serial.begin(115200);
   //The program will wait for serial to be ready up to 10 sec then it will contunue anyway  
     for (int i=1; i<=10; i++){
          delay(1000);
     if (Serial){
         break;
       }
     }
    Serial.println("PCA9685 Oscillator test");
    Serial.println("yet not available for your board."); // please help adapt the code!  
  //===============================
}

void loop() {}

#endif // _BOARD_MAPLE_MINI_H_
